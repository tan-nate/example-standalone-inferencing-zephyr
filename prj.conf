## CMakeLists.txt
```
cmake_minimum_required(VERSION 3.13.1)

# Set project name
project(example-standalone-inferencing-zephyr)

# Ensure correct C++ standard
set(CMAKE_CXX_STANDARD 11)
set(CMAKE_CXX_STANDARD_REQUIRED ON)

# Find Zephyr SDK
find_package(Zephyr REQUIRED HINTS $ENV{ZEPHYR_BASE})

# Enable colored output for debugging
zephyr_compile_options(-fdiagnostics-color=always)

# Enable hardware acceleration for DSP and ML inference
add_definitions(
    -DEI_CLASSIFIER_TFLITE_ENABLE_CMSIS_NN=1
    -DARM_MATH_LOOPUNROLL
)

# Define source directories
set(SOURCE_DIRS
    src
    tflite-model
    model-parameters
)

# Add include directories
include_directories(${SOURCE_DIRS})

# Add Edge Impulse SDK (Ensure correct path)
add_subdirectory(edge-impulse-sdk)

# Collect all .cpp source files in tflite-model directory
file(GLOB_RECURSE MODEL_FILES "tflite-model/*.cpp")

# Define the list of source files
set(SOURCE_FILES
    ${MODEL_FILES}
    src/main.cpp
    src/adbms_main.cpp
    src/adBms_Application.cpp
)

# Add sources to the Zephyr application
target_sources(app PRIVATE ${SOURCE_FILES})
```

## prj.conf
```kconfig
CONFIG_GPIO=y
CONFIG_SPI=y
# enable c++ support
CONFIG_CPP=y
CONFIG_GLIBCXX_LIBCPP=y
CONFIG_NEWLIB_LIBC=y
CONFIG_NEWLIB_LIBC_FLOAT_PRINTF=y
CONFIG_FPU=y

CONFIG_MAIN_STACK_SIZE=8192
CONFIG_CONSOLE_SUBSYS=y
CONFIG_CONSOLE_GETLINE=y

# Logging
CONFIG_LOG=y
CONFIG_ASSERT=y
CONFIG_LOG_PROCESS_THREAD_STACK_SIZE=1024

################################################################################
# Debug configuration (logger using RTT)

# CONFIG_LOG2_MODE_DEFERRED=y
# CONFIG_USE_SEGGER_RTT=y
# CONFIG_SEGGER_RTT_BUFFER_SIZE_UP=4096
# CONFIG_LOG_BACKEND_RTT=y
# CONFIG_LOG_PRINTK=y
```

## src/main.cpp
```c
/*******************************************************************************
Copyright (c) 2020 - Analog Devices Inc. All Rights Reserved.
This software is proprietary & confidential to Analog Devices, Inc.
and its licensor.
------------------------------------------------------------------------------*/

/* Includes ------------------------------------------------------------------*/
#include <zephyr/kernel.h>
#include <zephyr/device.h>
#include <zephyr/drivers/spi.h>
#include <zephyr/drivers/gpio.h>
#include <zephyr/sys/printk.h>
#include "adbms_main.h"
#include "common.h"

/* SPI Configuration */
#define SPI_NODE DT_NODELABEL(spi1)
#define CS_GPIO_NODE DT_ALIAS(cs)

static const struct device *spi_dev = DEVICE_DT_GET(SPI_NODE);
static const struct gpio_dt_spec chip_select = GPIO_DT_SPEC_GET_OR(CS_GPIO_NODE, gpios, {0});

void spi_init(void);

int main(void) {
    k_sleep(K_MSEC(1000));
    printk("Initialization Check.\n");
    k_sleep(K_MSEC(1000));

    spi_init();
    adbms_main();
    return 0;
}

void spi_init() {
    if (!device_is_ready(spi_dev)) {
        printk("SPI device not found!\n");
        return;
    }

    if (chip_select.port && device_is_ready(chip_select.port)) {
        gpio_pin_configure_dt(&chip_select, GPIO_OUTPUT_ACTIVE);
        gpio_pin_set_dt(&chip_select, 1);
    } else {
        printk("Chip select GPIO not found or not ready!\n");
    }

    printk("SPI initialized.\n");
}
```

## include/adbms_main.h
```c
/*******************************************************************************
Copyright (c) 2020 - Analog Devices Inc. All Rights Reserved.
This software is proprietary & confidential to Analog Devices, Inc.
and its licensor.
******************************************************************************
* @file:    adbms_main.h
* @brief:   adbms main Heade file
* @version: $Revision$
* @date:    $Date$
* Developed by: ADIBMS Software team, Bangalore, India
*****************************************************************************/
/** @addtogroup MAIN
*  @{
*
*/

/** @addtogroup ADBMS_MAIN MAIN
*  @{
*
*/
#ifndef _ADBMS6830_MAIN_H
#define _ADBMS6830_MAIN_H

#include "common.h"
#include "adBms6830Data.h"
#include "adBms6830GenericType.h"
#include "adBms6830ParseCreate.h"
#include "mcuWrapper.h"


void adbms_main(void);

#endif
/** @}*/
/** @}*/
```

## include/common.h
```c
/*******************************************************************************
Copyright (c) 2020 - Analog Devices Inc. All Rights Reserved.
This software is proprietary & confidential to Analog Devices, Inc.
and its licensor.
******************************************************************************
* @file:    common.h
* @brief:   Standard common header files
* @version: $Revision$
* @date:    $Date$
* Developed by: ADIBMS Software team, Bangalore, India
*****************************************************************************/
#ifndef __COMMON_H_
#define __COMMON_H_

// Zephyr 3.1.x and newer uses different include scheme
#include <zephyr/kernel.h>
#include <zephyr/drivers/spi.h>
#include <zephyr/sys/printk.h>      // For debug printing

// Edge Impulse SDK
#include "edge-impulse-sdk/classifier/ei_run_classifier.h"
#include "edge-impulse-sdk/dsp/numpy.hpp"

#ifdef EI_NORDIC
#include <nrfx_clock.h>
#endif

#endif /* __COMMON_H_ */
```

## include/mcuWrapper.h
```c
/*******************************************************************************
Copyright (c) 2020 - Analog Devices Inc. All Rights Reserved.
This software is proprietary & confidential to Analog Devices, Inc.
and its licensor.
*******************************************************************************
* @file:    mcuWrapper.h
* @brief:   Generic wrapper header file
* @version: $Revision$
* @date:    $Date$
* Developed by: ADIBMS Software team, Bangalore, India
*****************************************************************************/
/** @addtogroup MUC_DRIVER
*  @{
*
*/

/** @addtogroup SPI_DRIVER SPI DRIVER
*  @{
*
*/
#ifndef __ADBMSWRAPPER_H
#define __ADBMSWRAPPER_H
#include "common.h"
#include <zephyr/kernel.h>
#include <zephyr/drivers/spi.h>
#include <zephyr/drivers/gpio.h>
#include <zephyr/drivers/i2c.h>
#include <zephyr/drivers/uart.h>
#include <zephyr/sys/util.h>

/* Define chip select pin based on Zephyr GPIO API */
#define CS_PIN DT_ALIAS(cs_pin)
#define GPIO_PORT DT_ALIAS(cs_gpio)

void Delay_ms(uint32_t delay);
void adBmsCsLow(void);
void adBmsCsHigh(void);
void spiWriteBytes
( 
  uint16_t size,                                /*Option: Number of bytes to be written on the SPI port*/
  uint8_t *tx_Data                              /*Array of bytes to be written on the SPI port*/
);
void spiWriteReadBytes
(
  uint8_t *tx_data,                             /*array of data to be written on SPI port*/
  uint8_t *rx_data,                             /*Input: array that will store the data read by the SPI port*/
  uint16_t size                             /*Option: number of bytes*/
);
void spiReadBytes(uint16_t size, uint8_t *rx_data);
void startTimer(void);
void stopTimer(void);
uint32_t getTimCount(void);
void adBmsWakeupIc(uint8_t total_ic);

#endif
/** @}*/
/** @}*/
```
